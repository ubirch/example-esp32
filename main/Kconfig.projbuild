## main/Kconfig.projbuild
```kconfig
menu "UBIRCH Application"

config UBIRCH_BACKEND_DATA_URL
    string "ubirch-protocol data URL"
    default "https://niomon.prod.ubirch.com"
    help
        The URL to send ubirch protocol messages to.

config UBIRCH_BACKEND_KEY_SERVER_URL
	string "ubirch key server URL"
	default "https://key.prod.ubirch.com/api/keyService/v1/pubkey/mpack"
	help
		The key server URL to register public keys.

config UBIRCH_BACKEND_UPDATE_KEY_SERVER_URL
	string "ubirch key server URL"
	default "https://key.prod.ubirch.com/api/keyService/v1/pubkey"
	help
		The key server URL to update public keys.

config UBIRCH_DEFAULT_INTERVAL
	int "ubirch sensor measuring interval (ms)"
	default 30000
	help
		The default measuring interval.

config UBIRCH_AUTH
	string "ubirch authentication string"
	default "passwort-1234-lol"
	help
		The passwort for authentication at the ubirch backend.

config UBIRCH_BACKEND_PUBLIC_KEY
    string "ubirch backend public key"
    default "74BIrQbAKFrwF3AJOBgwxGzsAl0B2GCF51pPAEHC5pA="
    help
        The backend public key.

config UBIRCH_KEY_LIFETIME_YEARS
	int "ubirch key lifetime in years"
	default 1
	help
		The default key lifetime.

endmenu
```

## sdkconfig.defaults
```kconfig
#
# Default configuration for sdkconfig.
#

#
# Bootloader config
#
CONFIG_BOOTLOADER_LOG_LEVEL_INFO=y
CONFIG_BOOTLOADER_LOG_LEVEL=3

#
# Serial flasher config
#
CONFIG_ESPTOOLPY_FLASHSIZE_4MB=y
CONFIG_ESPTOOLPY_FLASHSIZE="4MB"
CONFIG_ESPTOOLPY_MONITOR_BAUD_921600B=y
CONFIG_ESPTOOLPY_MONITOR_BAUD=921600

#
# Partition Table
#
CONFIG_PARTITION_TABLE_TWO_OTA=y
CONFIG_PARTITION_TABLE_FILENAME="partitions_two_ota.csv"

#
# UBIRCH Application
#
CONFIG_UBIRCH_BACKEND_DATA_URL="https://niomon.prod.ubirch.com/"
CONFIG_UBIRCH_BACKEND_PUBLIC_KEY="74BIrQbAKFrwF3AJOBgwxGzsAl0B2GCF51pPAEHC5pA="
CONFIG_UBIRCH_BACKEND_KEY_SERVER_URL="https://key.prod.ubirch.com/api/keyService/v1/pubkey/mpack"
CONFIG_UBIRCH_DEFAULT_INTERVAL=10000
CONFIG_UBIRCH_AUTH="123"

#
# UBIRCH
#
CONFIG_FIRMWARE_UPGRADE_BASE_URL="https://s3-eu-west-1.amazonaws.com/fw.prod.ubirch.com"
# CONFIG_FIRMWARE_FILE_OVERRIDE is not set
CONFIG_FIRMWARE_UPGRADE_FILE="dev/firmware.bin"

#
# Compiler options
#
CONFIG_COMPILER_CXX_EXCEPTIONS=y
CONFIG_COMPILER_CXX_EXCEPTIONS_EMG_POOL_SIZE=0

#
# ESP32-specific
#
CONFIG_ESP32_DEFAULT_CPU_FREQ_240=y
CONFIG_ESP32_DEFAULT_CPU_FREQ_MHZ=240

#
# Common ESP-related
#
CONFIG_ESP_SYSTEM_EVENT_TASK_STACK_SIZE=2048
CONFIG_ESP_MAIN_TASK_STACK_SIZE=4096

#
# Wi-Fi
#
CONFIG_ESP32_WIFI_DEBUG_LOG_VERBOSE=y
CONFIG_ESP32_WIFI_DEBUG_LOG_MODULE_WIFI=y
CONFIG_ESP32_WIFI_DEBUG_LOG_SUBMODULE=y
CONFIG_ESP32_WIFI_DEBUG_LOG_SUBMODULE_ALL=y

#
# FreeRTOS
#
CONFIG_FREERTOS_HZ=1000
CONFIG_FREERTOS_CHECK_STACKOVERFLOW_PTRVAL=y
CONFIG_FREERTOS_INTERRUPT_BACKTRACE=y
CONFIG_FREERTOS_THREAD_LOCAL_STORAGE_POINTERS=3
CONFIG_FREERTOS_IDLE_TASK_STACKSIZE=1024

#
# LWIP
#
CONFIG_LWIP_MAX_SOCKETS=4
CONFIG_LWIP_SO_RCVBUF=y
CONFIG_LWIP_ETHARP_TRUST_IP_MAC=y
CONFIG_LWIP_ESP_GRATUITOUS_ARP=y CONFIG_LWIP_GARP_TMR_INTERVAL=60

#
# TCP
#
CONFIG_LWIP_TCP_SYNMAXRTX=6
CONFIG_LWIP_TCP_MSS=1436

#
# UDP
#
CONFIG_LWIP_TCPIP_TASK_STACK_SIZE=2048

#
# mbedTLS
#
CONFIG_MBEDTLS_SSL_MAX_CONTENT_LEN=16384
CONFIG_MBEDTLS_SHA512_C=n

#
# Newlib
#
CONFIG_NEWLIB_NANO_FORMAT=y

#
# OpenSSL
#
CONFIG_OPENSSL_ASSERT_DO_NOTHING=y
# CONFIG_OPENSSL_ASSERT_EXIT is not set

# Deprecated options for backward compatibility
CONFIG_LOG_BOOTLOADER_LEVEL_WARN=y
# CONFIG_LOG_BOOTLOADER_LEVEL_INFO is not set
CONFIG_LOG_BOOTLOADER_LEVEL=2
CONFIG_MONITOR_BAUD_921600B=y
CONFIG_MONITOR_BAUD=921600
CONFIG_CXX_EXCEPTIONS=y
CONFIG_CXX_EXCEPTIONS_EMG_POOL_SIZE=0
CONFIG_SYSTEM_EVENT_TASK_STACK_SIZE=2048
CONFIG_MAIN_TASK_STACK_SIZE=4096
CONFIG_TCP_SYNMAXRTX=6
CONFIG_TCP_MSS=1436
CONFIG_TCPIP_TASK_STACK_SIZE=2048
```

## test/main/Kconfig.projbuild
```kconfig
menu "UBIRCH Application"

config UBIRCH_BACKEND_DATA_URL
    string "ubirch-protocol data URL"
    default "https://niomon.prod.ubirch.com"
    help
        The URL to send ubirch protocol messages to.

config UBIRCH_BACKEND_KEY_SERVER_URL
	string "ubirch key server URL"
	default "https://key.prod.ubirch.com/api/keyService/v1/pubkey/mpack"
	help
		The key server URL to register public keys.

config UBIRCH_BACKEND_UPDATE_KEY_SERVER_URL
	string "ubirch key server URL"
	default "https://key.prod.ubirch.com/api/keyService/v1/pubkey"
	help
		The key server URL to update public keys.

config UBIRCH_DEFAULT_INTERVAL
	int "ubirch sensor measuring interval (ms)"
	default 30000
	help
		The default measuring interval.

config UBIRCH_MULTIPLE_IDS
    bool "Enable multipe ids"
    default n
    help
        The device can handle multiple ids at once.

config UBIRCH_BACKEND_PUBLIC_KEY
    string "ubirch backend public key"
    default "74BIrQbAKFrwF3AJOBgwxGzsAl0B2GCF51pPAEHC5pA="
    help
        The backend public key.

config UBIRCH_KEY_LIFETIME_YEARS
	int "ubirch key lifetime in years"
	default 1
	help
		The default key lifetime.

config UBIRCH_REGISTER_THING
	bool "Enable automatic thing registering"
	default y
	help
		The device can register things automatically (token in NVS required).

config UBIRCH_REGISTER_THING_URL
	string "ubirch register thing URL"
	default "https://api.console.prod.ubirch.com/ubirch-web-ui/api/v1/devices/create?with_api_info=true"
	help
		The url where new things can be registered.

config BURICH_GET_INFO_OF_THING_URL
	string "ubirch get info of thing URL"
	default "https://api.console.prod.ubirch.com/ubirch-web-ui/api/v1/devices/api-config"
	help
		The url where info about a thing can be retrieved
endmenu
```
